## main/Kconfig.projbuild
```kconfig
menu "Example Configuration"

    config EXAMPLE_WIFI_SSID
        string "Wi-Fi SSID"
        default "myssid"
        help
            Wi-Fi SSID (network name) for the example to connect to

    config EXAMPLE_WIFI_PASSWORD
        string "Wi-Fi Password"
        default "mypassword"
        help
            Wi-Fi password (WPA or WPA2) for the example to use

    config EXAMPLE_SLEEP_MODE_ENABLE
        bool "Enable Sleep Mode"

        choice EXAMPLE_SLEEP_TYPE_CONFIG
            prompt "Configure Sleep Mode Type"
            default EXAMPLE_MODEM_SLEEP
            depends on EXAMPLE_SLEEP_MODE_ENABLE
            help
                Configure the sleep mode for the example

            config EXAMPLE_LIGHT_SLEEP
                bool "Light Sleep Mode"
            config EXAMPLE_DEEP_SLEEP
                bool "Deep Sleep Mode"
            config EXAMPLE_MODEM_SLEEP
                bool "MODEM Sleep Mode"
                    choice EXAMPLE_MODEM_SLEEP
                        prompt "Configure MODEM Sleep Type"
                        default EXAMPLE_MODEM_SLEEP_MAX
                        help
                            Configure MODEM Sleep Type - None, MIN or MAX

                        config EXAMPLE_MODEM_SLEEP_NONE
                            bool "MODEM Sleep NONE"
                            depends on EXAMPLE_MODEM_SLEEP
                        config EXAMPLE_MODEM_SLEEP_MIN
                            bool "MODEM Sleep MIN"
                            depends on EXAMPLE_MODEM_SLEEP
                        config EXAMPLE_MODEM_SLEEP_MAX
                            bool "MODEM Sleep MAX"
                            depends on EXAMPLE_MODEM_SLEEP
                    endchoice
        endchoice

    config EXAMPLE_TWT_ENABLE
        bool "Enable Target Wake Time (TWT)"
        depends on SOC_WIFI_HE_SUPPORT

        config EXAMPLE_TWT_WAKE_INTERVAL_MANTISSA
            int "TWT Wake Interval Mantissa"
            range 1 65535
            default 512
            depends on EXAMPLE_TWT_ENABLE
            help
                TWT Wake Interval = TWT Wake Interval Mantissa * (2 ^ TWT Wake Interval Exponent), unit: us

        config EXAMPLE_TWT_WAKE_INTERVAL_EXPONENT
            int "TWT Wake Interval Exponent"
            range 0 31
            default 10
            depends on EXAMPLE_TWT_ENABLE
            help
                TWT Wake Interval = TWT Wake Interval Mantissa * (2 ^ TWT Wake Interval Exponent), unit: us

        config EXAMPLE_TWT_MIN_WAKE_DURATION
            int "TWT Minumum wake duration"
            range 1 255
            default 255
            depends on EXAMPLE_TWT_ENABLE

    config EXAMPLE_PM_ENABLE
        bool "Enable Power Management (DFS)"
        depends on PM_ENABLE

        choice EXAMPLE_MAX_CPU_FREQ
            prompt "Maximum CPU frequency"
            default EXAMPLE_MAX_CPU_FREQ_80
            depends on EXAMPLE_PM_ENABLE
            help
                Maximum CPU frequency to use for dynamic frequency scaling.

            config EXAMPLE_MAX_CPU_FREQ_80
                bool "80 MHz"
            config EXAMPLE_MAX_CPU_FREQ_120
                bool "120 MHz"
                depends on IDF_TARGET_ESP32C2
            config EXAMPLE_MAX_CPU_FREQ_160
                bool "160 MHz"
                depends on !IDF_TARGET_ESP32C2
            config EXAMPLE_MAX_CPU_FREQ_240
                bool "240 MHz"
                depends on IDF_TARGET_ESP32 || IDF_TARGET_ESP32S2 || IDF_TARGET_ESP32S3
        endchoice

        choice EXAMPLE_MIN_CPU_FREQ
            prompt "Minimum CPU frequency"
            default EXAMPLE_MIN_CPU_FREQ_10M
            depends on EXAMPLE_PM_ENABLE
            help
                Minimum CPU frequency to use for dynamic frequency scaling.
                Should be set to XTAL frequency or XTAL frequency divided by integer.

            config EXAMPLE_MIN_CPU_FREQ_40M
                bool "40 MHz (use with 40MHz XTAL)"
                depends on XTAL_FREQ_40 || XTAL_FREQ_AUTO
            config EXAMPLE_MIN_CPU_FREQ_20M
                bool "20 MHz (use with 40MHz XTAL)"
                depends on XTAL_FREQ_40 || XTAL_FREQ_AUTO
            config EXAMPLE_MIN_CPU_FREQ_10M
                bool "10 MHz (use with 40MHz XTAL)"
                depends on XTAL_FREQ_40 || XTAL_FREQ_AUTO
            config EXAMPLE_MIN_CPU_FREQ_26M
                bool "26 MHz (use with 26MHz XTAL)"
                depends on XTAL_FREQ_26 || XTAL_FREQ_AUTO
            config EXAMPLE_MIN_CPU_FREQ_13M
                bool "13 MHz (use with 26MHz XTAL)"
                depends on XTAL_FREQ_26 || XTAL_FREQ_AUTO
        endchoice

        config EXAMPLE_MAX_CPU_FREQ_MHZ
            int
            depends on EXAMPLE_PM_ENABLE
            default 80 if EXAMPLE_MAX_CPU_FREQ_80
            default 120 if EXAMPLE_MAX_CPU_FREQ_120
            default 160 if EXAMPLE_MAX_CPU_FREQ_160
            default 240 if EXAMPLE_MAX_CPU_FREQ_240

        config EXAMPLE_MIN_CPU_FREQ_MHZ
            int
            depends on EXAMPLE_PM_ENABLE
            default 40 if EXAMPLE_MIN_CPU_FREQ_40M
            default 20 if EXAMPLE_MIN_CPU_FREQ_20M
            default 10 if EXAMPLE_MIN_CPU_FREQ_10M
            default 26 if EXAMPLE_MIN_CPU_FREQ_26M
            default 13 if EXAMPLE_MIN_CPU_FREQ_13M
endmenu
```
